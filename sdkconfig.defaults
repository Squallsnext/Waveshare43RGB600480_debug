## sdkconfig.defaults
```kconfig
# Waveshare 4.3" RGB LCD + ESP32-S3 + LVGL 9.4
# Stability-first configuration

# Target & CPU
CONFIG_IDF_TARGET="esp32s3"
CONFIG_ESP32S3_DEFAULT_CPU_FREQ_240=y

# FreeRTOS
CONFIG_FREERTOS_HZ=1000
CONFIG_FREERTOS_USE_TRACE_FACILITY=y
CONFIG_FREERTOS_GENERATE_RUN_TIME_STATS=y
CONFIG_ESP_MAIN_TASK_STACK_SIZE=8192

# PSRAM (Octal, 120MHz) - 16MB typical for Waveshare
CONFIG_SPIRAM=y
CONFIG_SPIRAM_MODE_OCT=y
CONFIG_SPIRAM_SPEED_120M=y
CONFIG_SPIRAM_MALLOC_ALWAYSINTERNAL=16384

# LCD RGB Peripheral (ISR-safe, VSync restart)
CONFIG_LCD_RGB_ISR_IRAM_SAFE=y
CONFIG_LCD_RGB_RESTART_IN_VSYNC=y

# Compiler Optimization
CONFIG_COMPILER_OPTIMIZATION_PERF=y

# Logging (INFO default, DEBUG available via menuconfig)
CONFIG_LOG_DEFAULT_LEVEL_INFO=y
CONFIG_LOG_MAXIMUM_LEVEL_DEBUG=y

# NVS (no encryption for now)
CONFIG_NVS_ENCRYPTION=n
```
